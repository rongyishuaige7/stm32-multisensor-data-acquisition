/**
 * @file oled.c
 * @brief SSD1306 128x64 I2C OLED，软件 I2C 实现（PB6=SCL, PB7=SDA, 地址 0x3C）
 *
 * 依赖 HAL GPIO，不占用硬件 I2C 外设。
 * 帧缓冲 1KB，6x8 ASCII 字库（0x20..0x7E）。
 */

#include "oled.h"
#include "esp_uart.h"
#include "board_pins.h"
#include "stm32f1xx_hal.h"
#include <stdio.h>
#include <string.h>

/* ============ 软件 I2C 底层 ============ */

static void i2c_delay(void)
{
    /* ~1us 级延时，64MHz 下循环若干次即可，SSD1306 I2C 最快 400kHz 也够 */
    for (volatile int i = 0; i < 8; i++) {
        __NOP();
    }
}

static void scl_write(int v)
{
    HAL_GPIO_WritePin(OLED_SCL_GPIO_Port, OLED_SCL_Pin, v ? GPIO_PIN_SET : GPIO_PIN_RESET);
}

static void sda_write(int v)
{
    HAL_GPIO_WritePin(OLED_SDA_GPIO_Port, OLED_SDA_Pin, v ? GPIO_PIN_SET : GPIO_PIN_RESET);
}

static int sda_read(void)
{
    return HAL_GPIO_ReadPin(OLED_SDA_GPIO_Port, OLED_SDA_Pin) ? 1 : 0;
}

static void sda_mode(int out)
{
    GPIO_InitTypeDef g = {0};
    g.Pin = OLED_SDA_Pin;
    g.Speed = GPIO_SPEED_FREQ_HIGH;
    g.Pull = GPIO_PULLUP;
    /* 这里用推挽而不是真正的开漏，因为 SSD1306 模块板上已经有上拉电阻，
     * MCU 推挽输出更干净；读 ACK 时切回上拉输入。 */
    g.Mode = out ? GPIO_MODE_OUTPUT_PP : GPIO_MODE_INPUT;
    HAL_GPIO_Init(OLED_SDA_GPIO_Port, &g);
}

static void i2c_start(void)
{
    sda_mode(1);
    sda_write(1);
    scl_write(1);
    i2c_delay();
    sda_write(0);
    i2c_delay();
    scl_write(0);
    i2c_delay();
}

static void i2c_stop(void)
{
    sda_mode(1);
    sda_write(0);
    i2c_delay();
    scl_write(1);
    i2c_delay();
    sda_write(1);
    i2c_delay();
}

static bool i2c_write_byte(uint8_t b)
{
    sda_mode(1);
    for (int i = 0; i < 8; i++) {
        sda_write((b & 0x80) ? 1 : 0);
        b <<= 1;
        i2c_delay();
        scl_write(1);
        i2c_delay();
        scl_write(0);
        i2c_delay();
    }
    /* 读 ACK */
    sda_mode(0);
    i2c_delay();
    scl_write(1);
    i2c_delay();
    int ack = sda_read();
    scl_write(0);
    sda_mode(1);
    i2c_delay();
    return ack == 0;
}

/* ============ SSD1306 命令 / 数据 ============ */

static void ssd_cmd(uint8_t c)
{
    i2c_start();
    (void)i2c_write_byte((uint8_t)(OLED_I2C_ADDR << 1)); /* write */
    (void)i2c_write_byte(0x00);                          /* Co=0, D/C#=0 */
    (void)i2c_write_byte(c);
    i2c_stop();
}

static void ssd_data(const uint8_t *d, uint16_t n)
{
    i2c_start();
    (void)i2c_write_byte((uint8_t)(OLED_I2C_ADDR << 1));
    (void)i2c_write_byte(0x40); /* Co=0, D/C#=1 */
    for (uint16_t i = 0; i < n; i++) {
        (void)i2c_write_byte(d[i]);
    }
    i2c_stop();
}

/* ============ 帧缓冲 & 6x8 ASCII 字库（0x20..0x7E） ============ */

static uint8_t s_buf[128 * 8]; /* page 排列：每列 1 字节 = 该 page 8 行像素 */

/* 紧凑 6x8 字库：每个字符 6 字节（最后一列一般为 0 做间距） */
static const uint8_t FONT6x8[][6] = {
    {0x00,0x00,0x00,0x00,0x00,0x00}, /* ' ' */
    {0x00,0x00,0x5F,0x00,0x00,0x00}, /* ! */
    {0x00,0x07,0x00,0x07,0x00,0x00}, /* " */
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    {0x02,0x01,0x02,0x04,0x02,0x00}, /* ~ */
};

static void draw_char(uint8_t x, uint8_t page, char ch)
{
    if (x > 122 || page > 7)
        return;
    uint8_t idx;
    if ((uint8_t)ch < 0x20 || (uint8_t)ch > 0x7E)
        idx = 0; /* 非 ASCII 用空格占位（避免中文等越界） */
    else
        idx = (uint8_t)ch - 0x20;
    const uint8_t *g = FONT6x8[idx];
    uint16_t base = (uint16_t)page * 128U + x;
    for (int i = 0; i < 6; i++) {
        s_buf[base + i] = g[i];
    }
}

void oled_draw_str(uint8_t x, uint8_t page, const char *s)
{
    while (*s && x <= 122) {
        draw_char(x, page, *s++);
        x += 6;
    }
}

/* ============ 对外接口 ============ */

static void gpio_init_pins(void)
{
    __HAL_RCC_GPIOB_CLK_ENABLE();
    GPIO_InitTypeDef g = {0};
    g.Mode = GPIO_MODE_OUTPUT_PP;
    g.Speed = GPIO_SPEED_FREQ_HIGH;
    g.Pull = GPIO_PULLUP;
    g.Pin = OLED_SCL_Pin;
    HAL_GPIO_Init(OLED_SCL_GPIO_Port, &g);
    g.Pin = OLED_SDA_Pin;
    HAL_GPIO_Init(OLED_SDA_GPIO_Port, &g);
    scl_write(1);
    sda_write(1);
}

void oled_clear(void)
{
    memset(s_buf, 0, sizeof(s_buf));
}

void oled_show(void)
{
    for (uint8_t page = 0; page < 8; page++) {
        ssd_cmd((uint8_t)(0xB0 | page)); /* page */
        ssd_cmd(0x00);                   /* 列低 */
        ssd_cmd(0x10);                   /* 列高 */
        ssd_data(&s_buf[(uint16_t)page * 128U], 128);
    }
}

void oled_init(void)
{
    gpio_init_pins();
    HAL_Delay(50);

    static const uint8_t init_seq[] = {
        0xAE,       /* display off */
        0x20, 0x02, /* page addressing */
        0xB0,
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        0xAF,
    };
    for (unsigned i = 0; i < sizeof(init_seq); i++)
        ssd_cmd(init_seq[i]);

    oled_clear();
    oled_show();
}

static void fmt_temp_c(char *out, size_t out_size, float temp_c)
{
    int32_t x100 = (int32_t)(temp_c * 100.0f + (temp_c >= 0.0f ? 0.5f : -0.5f));
    const char *sign = "";
    uint32_t abs_value;

    if (x100 < 0) {
        sign = "-";
        abs_value = (uint32_t)(-x100);
    } else {
        abs_value = (uint32_t)x100;
    }

    (void)snprintf(out, out_size, "%s%lu.%02lu",
                   sign,
                   (unsigned long)(abs_value / 100U),
                   (unsigned long)(abs_value % 100U));
}

void oled_render_snapshot(const sensor_snapshot_t *snap, bool wifi_online)
{
    if (!snap)
        return;
    char line[24];

    oled_clear();
    oled_draw_str(0, 0, "Sensor Monitor");
    oled_draw_str(96, 0, wifi_online ? " NET" : " ---");

    if (snap->temp_c > -900.0f) {
        char temp[16];
        fmt_temp_c(temp, sizeof(temp), snap->temp_c);
        snprintf(line, sizeof(line), "TEMP:%s C", temp);
    } else {
        snprintf(line, sizeof(line), "TEMP: ---- C");
    }
    oled_draw_str(0, 2, line);

    snprintf(line, sizeof(line), "RPM:%5u", (unsigned)snap->rpm);
    oled_draw_str(0, 3, line);

    snprintf(line, sizeof(line), "PRESS:%5u g", (unsigned)snap->pressure_g);
    oled_draw_str(0, 4, line);

    snprintf(line, sizeof(line), "Light:%s", snap->light_on ? "ON " : "OFF");
    oled_draw_str(0, 5, line);

    {
        const char *ip = esp_uart_get_ip();
        if (ip && ip[0]) {
            snprintf(line, sizeof(line), "IP:%s", ip);
        } else {
            snprintf(line, sizeof(line), "IP: ---");
        }
        oled_draw_str(0, 6, line);
    }

    snprintf(line, sizeof(line), "ALM:0x%02X Up:%lus",
             (unsigned)snap->alarm, (unsigned long)snap->uptime_s);
    oled_draw_str(0, 7, line);

    oled_show();
}
